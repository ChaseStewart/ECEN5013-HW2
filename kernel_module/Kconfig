## kernel_module/Kconfig
```kconfig
config EXAMPLEMOD
    tristate "500 msec timer module"
    default n
    help
      This is the help string for this stupid module
      It will print an incrementing number every 500ms
```
